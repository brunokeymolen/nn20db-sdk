## demos/sift128/esp32/sift_persistent_search/sdkconfig.defaults
```kconfig
# =============================================================================
# nn20db sift_persistent_search — shared sdkconfig defaults
# Applied to ALL targets. Target-specific overrides live in:
#   sdkconfig.defaults.esp32p4  (HEX PSRAM at 200 MHz)
#   sdkconfig.defaults.esp32s3  (Octal PSRAM at 40 MHz)
# =============================================================================

# -----------------------------------------------------------------------------
# FreeRTOS
# Raise the default pthread/task stack sizes so nn20db search tasks don't
# overflow. The search task itself is created with 32 KB (see app_main), but
# the pthread pool used internally by nn20db needs headroom too.
# -----------------------------------------------------------------------------
CONFIG_PTHREAD_TASK_STACK_SIZE_DEFAULT=8192
CONFIG_FREERTOS_IDLE_TASK_STACKSIZE=2048

# -----------------------------------------------------------------------------
# FAT filesystem
# nn20db uses the SD card via FAT/VFS. Sector size must match the SD card
# (modern cards use 4096-byte physical sectors). LFN disabled for 8.3 paths.
# Two volumes: one for the SD card mount point.
# -----------------------------------------------------------------------------
CONFIG_FATFS_SECTOR_4096=y
CONFIG_FATFS_LFN_NONE=y
CONFIG_FATFS_VOLUME_COUNT=2
CONFIG_FATFS_TIMEOUT_MS=10000
CONFIG_FATFS_PER_FILE_CACHE=y
# Fast-seek: O(1) seeks in read-only files via a per-file cluster map.
# Essential for nn20db random reads inside 128 MB lane files (requires the
# DB opened with NN20DB_STORAGE_FLAGS_READ_ONLY so lanes are O_RDONLY).
CONFIG_FATFS_USE_FASTSEEK=y
CONFIG_FATFS_FAST_SEEK_BUFFER_SIZE=64

# -----------------------------------------------------------------------------
# VFS
# Enough VFS slots for SD card + internal flash.
# -----------------------------------------------------------------------------
CONFIG_VFS_MAX_COUNT=8
```

## demos/sift128/esp32/sift_persistent_search/sdkconfig.defaults.esp32p4
```kconfig
# =============================================================================
# nn20db sift_persistent_search — esp32p4 sdkconfig defaults
# Merged automatically by idf.py set-target esp32p4 (alongside sdkconfig.defaults).
# =============================================================================

# -----------------------------------------------------------------------------
# PSRAM — esp32p4 uses HEX (8-line) PSRAM at 200 MHz
#
# CONFIG_SPIRAM             — enable the PSRAM hardware driver
# CONFIG_SPIRAM_MODE_HEX    — 8-line HEX mode required by the P4 PSRAM die;
#                             different from S3 which uses Octal (OCT) mode
# CONFIG_SPIRAM_SPEED_200M  — 200 MHz bus speed for P4 HEX PSRAM
# CONFIG_SPIRAM_USE_MALLOC  — allow malloc() to fall back to PSRAM when
#                             internal SRAM is exhausted; used by nn20db for
#                             the storage-cache arena (128 × 4096 = 512 KB)
# CONFIG_SPIRAM_MALLOC_ALWAYSINTERNAL
#                           — objects smaller than 16 KB stay in fast internal
#                             SRAM; larger objects spill to PSRAM
# CONFIG_SPIRAM_MALLOC_RESERVE_INTERNAL
#                           — reserve 32 KB of internal SRAM for ISR/DMA/stack
# -----------------------------------------------------------------------------
CONFIG_SPIRAM=y
CONFIG_SPIRAM_MODE_HEX=y
CONFIG_SPIRAM_SPEED_200M=y
CONFIG_SPIRAM_USE_MALLOC=y
CONFIG_SPIRAM_MALLOC_ALWAYSINTERNAL=16384
CONFIG_SPIRAM_MALLOC_RESERVE_INTERNAL=32768
CONFIG_SPIRAM_ALLOW_STACK_EXTERNAL_MEMORY=y
CONFIG_SPIRAM_BOOT_INIT=y
CONFIG_SPIRAM_BOOT_HW_INIT=y
CONFIG_SPIRAM_MEMTEST=y
CONFIG_SPIRAM_PRE_CONFIGURE_MEMORY_PROTECTION=y

# -----------------------------------------------------------------------------
# FATFS — prefer external RAM for FAT work buffers on P4 (PSRAM available)
# -----------------------------------------------------------------------------
CONFIG_FATFS_ALLOC_PREFER_EXTRAM=y

# -----------------------------------------------------------------------------
# Chip revision — IDF's ESP32-P4 default targets MP silicon (rev >= v3.0),
# but early boards (e.g. Waveshare ESP32-P4) ship rev v1.0 chips. Without
# this, the bootloader is built requiring rev v3.1-v3.99 and esptool refuses
# to flash a v1.0 chip. Pin the <v3.0 revision family and set the minimum
# to v1.0 to match the actual silicon.
# -----------------------------------------------------------------------------
CONFIG_ESP32P4_SELECTS_REV_LESS_V3=y
CONFIG_ESP32P4_REV_MIN_100=y
```

## demos/sift128/esp32/sift_persistent_search/sdkconfig.defaults.esp32s3
```kconfig
# =============================================================================
# nn20db sift_persistent_search — esp32s3 sdkconfig defaults
# Merged automatically by idf.py set-target esp32s3 (alongside sdkconfig.defaults).
# =============================================================================

# -----------------------------------------------------------------------------
# PSRAM — 8 MB AP_3v3 embedded Octal PSRAM (ESP32-S3-WROOM / WROVER modules)
#
# CONFIG_SPIRAM             — enable the PSRAM hardware driver
# CONFIG_SPIRAM_MODE_OCT    — Octal (OPI) SPI mode required for AP_3v3 die;
#                             using quad mode causes "PSRAM chip not connected"
#                             boot abort on these modules
# CONFIG_SPIRAM_USE_MALLOC  — allow malloc() to fall back to PSRAM when
#                             internal SRAM is exhausted; essential for large
#                             contiguous allocations such as the nn20db
#                             storage-cache arena (128 × 4096 = 512 KB)
# CONFIG_SPIRAM_MALLOC_ALWAYSINTERNAL
#                           — objects smaller than this threshold always go to
#                             internal SRAM (faster); larger objects spill to
#                             PSRAM.  16384 (16 KB) is a good balance.
# CONFIG_SPIRAM_MALLOC_RESERVE_INTERNAL
#                           — keep this many bytes reserved in internal SRAM
#                             for ISR / DMA / stack allocations that must not
#                             reside in PSRAM.  32 KB is safe for this demo.
# -----------------------------------------------------------------------------
CONFIG_SPIRAM=y
CONFIG_SPIRAM_MODE_OCT=y
CONFIG_SPIRAM_USE_MALLOC=y
CONFIG_SPIRAM_MALLOC_ALWAYSINTERNAL=16384
CONFIG_SPIRAM_MALLOC_RESERVE_INTERNAL=32768

# -----------------------------------------------------------------------------
# FATFS — prefer external RAM for FAT work buffers on S3
# Frees internal SRAM for stack / DMA while PSRAM absorbs FAT I/O buffers.
# -----------------------------------------------------------------------------
CONFIG_FATFS_ALLOC_PREFER_EXTRAM=y
```
